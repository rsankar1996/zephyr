## CMakeLists.txt
```
# SPDX-License-Identifier: Apache-2.0

cmake_minimum_required(VERSION 3.20.0)
find_package(Zephyr REQUIRED HINTS $ENV{ZEPHYR_BASE})
project(button_poll)

target_sources(app PRIVATE 
        src/main.c
        src/led.c
        src/button.c
)

target_include_directories(app PRIVATE
        ${CMAKE_CURRENT_SOURCE_DIR}/include
)
```

## sample.yaml
```
sample:
  name: button_poll
tests:
  sample.basic.blinky:
    tags:
      - LED
      - gpio
    filter: dt_enabled_alias_with_parent_compat("led0", "gpio-leds")
    depends_on: gpio
    harness: led
    integration_platforms:
      - frdm_k64f
```

## prj.conf
```kconfig
CONFIG_GPIO=y
CONFIG_INPUT=y
CONFIG_USE_SEGGER_RTT=y
CONFIG_RTT_CONSOLE=y
CONFIG_UART_CONSOLE=n
```

## dts/bindings/led/my-gpio-leds.yaml
```yaml
description: wrapper for gpio led to add blink period property
compatible: "my,gpio-leds"

include: [gpio-leds.yaml]

properties:
  blink-period-ms:
    type: int
    required: false
    default: 500
```

## src/main.c
```c
#include <zephyr/kernel.h>
#include <zephyr/devicetree.h>
#include "led.h"
#include "button.h"

// Check for the device tree aliases
#if (!DT_HAS_ALIAS(led0))
	#error missing device tree alias for led0
#endif

#if (!DT_HAS_ALIAS(sw0))
	#error missing device tree alias for sw0
#endif

static struct button user_button;

const struct gpio_dt_spec  button_spec = GPIO_DT_SPEC_GET(SW0_NODE_ID, gpios);
const struct gpio_dt_spec  led_spec = GPIO_DT_SPEC_GET(LED0_NODE_ID, gpios);

int main()
{
	printk("Zephyr IRQ example\n");

	user_button.button_spec = &button_spec;

	if (led_init(&led_spec) < 0)
	{
		printk("ERR: led init failed\n");
		return 0;
	}

	if (button_init(&user_button) < 0)
	{
		printk("ERR: button init failed\n");
		return 0;
	}
	
	printk("all init suceessful\n");

	while (1)
	{
		if (true == button_read(&user_button))
		{
			gpio_pin_set_dt (&led_spec, 1);
		}
		else
		{
			gpio_pin_set_dt (&led_spec, 0);
		}
	}

	return 0;
}
```

## include/button.h
```c
#ifndef BUTTON_H
#define BUTTON_H

#include <zephyr/drivers/gpio.h>

//Get node identifier for parent sw node
#define SW0_NODE_ID		DT_ALIAS(sw0)

struct button
{
	const struct gpio_dt_spec * button_spec;
	struct gpio_callback button_cb;
};

int button_init (struct button * button);
bool button_read (struct button * button);

#endif /* BUTTON_H */
```

## include/led.h
```c
#ifndef LED_H
#define LED_H

#include <stdbool.h>
#include <stdint.h>
#include <errno.h>
#include <zephyr/drivers/gpio.h>

//Get node identifier for parent led node
#define LED0_NODE_ID		DT_ALIAS(led0)
#define LEDS_NODE_ID		DT_PARENT(LED0_NODE_ID)

int led_init(const struct gpio_dt_spec * led);
int led_toggle(const struct gpio_dt_spec * led);
bool led_get_state(void);
uint32_t led_get_period_ms(void);
const char * led_get_label(void);

#endif /* LED_H */
```

## src/button.c
```c
#include "button.h"

static void button_isr (const struct device *port, struct gpio_callback *cb, \ 
                               gpio_port_pins_t pins)
{
	printk("Button irq\n");	
}

int button_init (struct button * button)
{
	int ret;

	if (button == NULL)
	{
		printk("ERR: Null button pointer\n");
		return -EINVAL;
	}

	if (button->button_spec == NULL)
	{
		printk("ERR: Null button_spec pointer\n");
		return -EINVAL;
	}

	printk("INF: all button ok\n");

	// verify if the device is ready
	if (!gpio_is_ready_dt(button->button_spec))
	{
		printk("ERR: failed to get device ready\n");
		return -ENODEV;
	}

	ret = gpio_pin_configure_dt(button->button_spec, GPIO_INPUT);
	if (ret < 0)
	{
		printk("ERR: failed to configure button\n");
		return ret;
	}

#if 0
	ret = gpio_pin_interrupt_configure_dt(button->button_spec, GPIO_INT_EDGE_TO_INACTIVE);
	if (ret < 0)
	{
		printk("ERR: Interrupt config failed on the pin - %d\n", ret);
		return ret;
	}

	printk("checkpoint\n");
	
	// init gpio callback structure
	gpio_init_callback(&button->button_cb, button_isr, BIT(button->button_spec->pin));

	// add the isr
	ret = gpio_add_callback_dt(button->button_spec, &button->button_cb);
	if (ret < 0)
	{
		printk("ERR: failed to add isr now: %d\n", ret);
		return ret;
	}
#endif
	// configure the interrupt
	return 0;
}

bool button_read (struct button * button)
{
	bool status = false;

	if (1 == gpio_pin_get_dt (button->button_spec))
	{
		status = true;
	}

	return status;
}
```
