## CMakeLists.txt
```
# SPDX-License-Identifier: Apache-2.0

cmake_minimum_required(VERSION 3.20.0)
find_package(Zephyr REQUIRED HINTS $ENV{ZEPHYR_BASE})
project(thread)

target_sources(app PRIVATE 
            src/thread_0.c
            src/thread_1.c
)
```

## sample.yaml
```
sample:
  name: Thread
tests:
  sample.basic.blinky:
    tags:
      - LED
      - gpio
    filter: dt_enabled_alias_with_parent_compat("led0", "gpio-leds")
    depends_on: gpio
    harness: led
    integration_platforms:
      - frdm_k64f
```

## prj.conf
```kconfig
CONFIG_GPIO=y
CONFIG_USE_SEGGER_RTT=y
```

## boards/bgk_ra6e2.overlay
```dts
&{/leds} {
    compatible = "gpio-leds";
    blink-period-ms = <200>;
};
```

## src/thread_0.c
```c
#include <zephyr/kernel.h>
#include <zephyr/drivers/gpio.h>
#include <zephyr/devicetree.h>

#define STACK_SIZE 1024
#define PRIORITY 0

static void thread_0_run(void *p1, void *p2, void *p3)
{
	while (1) 
	{
		printk("Thread 0 running\n");
		k_sleep(K_SECONDS(1));
	}
}

K_THREAD_DEFINE(my_tid_0, STACK_SIZE, thread_0_run,
				NULL, NULL, NULL, PRIORITY, 0, 0);
```

## src/thread_1.c
```c
#include <zephyr/kernel.h>
#include <zephyr/drivers/gpio.h>
#include <zephyr/devicetree.h>

#define STACK_SIZE 1024
#define PRIORITY 0

static void thread_1_run(void *p1, void *p2, void *p3)
{
	while (1) 
	{
		printk("Thread 1 running\n");
		k_sleep(K_SECONDS(1));
	}
}

K_THREAD_DEFINE(my_tid_1, STACK_SIZE, thread_1_run,
				NULL, NULL, NULL, PRIORITY, 0, 0);
```
