## boards/renesas/bgk_ra6e2/Kconfig.bgk_ra6e2
```kconfig
# Copyright (c) 2024 Renesas Electronics Corporation
# SPDX-License-Identifier: Apache-2.0

config BOARD_BGK_RA6E2
	select SOC_R7FA6E2BB3CFM
```

## boards/renesas/bgk_ra6e2/board.yml
```yaml
board:
  name: bgk_ra6e2
  full_name: RA6E2 Beginners Kit
  vendor: renesas
  socs:
  - name: r7fa6e2bb3cfm
```

## boards/renesas/ek_ra6m4/ek_ra6m4_defconfig
```kconfig
# Copyright (c) 2024 Renesas Electronics Corporation
# SPDX-License-Identifier: Apache-2.0

# Enable GPIO
CONFIG_GPIO=y

# Enable Console
CONFIG_USE_SEGGER_RTT=y
CONFIG_RTT_CONSOLE=y
CONFIG_CONSOLE=y
CONFIG_PRINTK=y
```
